/* Generated by tools/generate_ats_map.py; do not edit. */
static const char *const states_1002[] = {"Off", "Normal", "Emergency", "Fault", "Unknown"};
static const char *const states_1003[] = {"Source 1", "Source 2", "Unknown"};
static const char *const states_1026[] = {"Disabled", "ABC", "CBA", "Unknown"};
static const char *const states_1027[] = {"Disabled", "ABC", "CBA", "Unknown"};
static const char *const states_1028[] = {"Disabled", "ABC", "CBA", "Unknown"};
static const char *const states_1036[] = {"Open", "Programmed", "Closed", "Reserved", "Unknown"};
static const char *const states_1037[] = {"Genset to genset", "Genset to utility", "Utility to utility", "Utility to generator-generator", "Unknown"};
static const char *const states_1038[] = {"Auto", "Manual", "Unknown"};
static const char *const states_1082[] = {"Not installed", "Standard", "Power", "Unknown"};
static const char *const states_1083[] = {"Not installed", "Standard", "Power", "Unknown"};
static const char *const states_1084[] = {"Not installed", "Standard", "Power", "Unknown"};
static const char *const states_1085[] = {"Not installed", "Standard", "Power", "Unknown"};
static const char *const states_1086[] = {"Not installed", "Normal", "Chicago", "Silence", "Unknown"};
static const char *const states_1116[] = {"DMO (manual notation)", "Day", "Week", "Month", "Unknown"};
static const char *const states_1124[] = {"DMO (manual notation)", "Day", "Week", "Month", "Unknown"};

const ats_point_def_t ats_points[ATS_POINT_COUNT] = {
    {0, 1001u, "ATS-System-overview-raw", "MPAC1500 old-map section 13; FC03 offset 0; read-only System overview raw.", 95, 0, NULL, 0, 1, 0, 0},
    {13, 1002u, "ATS-Contactor-position", "MPAC1500 old-map section 13; FC03 offset 0; read-only Contactor position.", 95, 5, states_1002, 0, 1, 0, 2},
    {13, 1003u, "ATS-Preferred-source", "MPAC1500 old-map section 13; FC03 offset 0; read-only Preferred source.", 95, 3, states_1003, 0, 1, 2, 1},
    {0, 1004u, "ATS-Top-warning-event-code", "MPAC1500 old-map section 13; FC03 offset 0; read-only Top warning/event code. One top event only, not all simultaneous alarms; code 256 means System Ready.", 95, 0, NULL, 0, 1, 3, 10},
    {3, 1005u, "ATS-Preferred-source-available", "MPAC1500 old-map section 13; FC03 offset 0; read-only Preferred source available.", 95, 0, NULL, 0, 1, 13, 1},
    {3, 1006u, "ATS-Standby-source-available", "MPAC1500 old-map section 13; FC03 offset 0; read-only Standby source available.", 95, 0, NULL, 0, 1, 14, 1},
    {0, 1007u, "ATS-Normal-voltage-L1-N", "MPAC1500 old-map section 13; FC03 offset 1; read-only Normal voltage L1-N. Controller-reported L-N voltage; site sensing/wiring qualification not established.", 5, 0, NULL, 1, 1, 0, 0},
    {0, 1008u, "ATS-Normal-voltage-L2-N", "MPAC1500 old-map section 13; FC03 offset 2; read-only Normal voltage L2-N. Controller-reported L-N voltage; site sensing/wiring qualification not established.", 5, 0, NULL, 2, 1, 0, 0},
    {0, 1009u, "ATS-Normal-voltage-L3-N", "MPAC1500 old-map section 13; FC03 offset 3; read-only Normal voltage L3-N. Controller-reported L-N voltage; site sensing/wiring qualification not established.", 5, 0, NULL, 3, 1, 0, 0},
    {0, 1010u, "ATS-Emergency-voltage-L1-N", "MPAC1500 old-map section 13; FC03 offset 4; read-only Emergency voltage L1-N. Controller-reported L-N voltage; site sensing/wiring qualification not established.", 5, 0, NULL, 4, 1, 0, 0},
    {0, 1011u, "ATS-Emergency-voltage-L2-N", "MPAC1500 old-map section 13; FC03 offset 5; read-only Emergency voltage L2-N. Controller-reported L-N voltage; site sensing/wiring qualification not established.", 5, 0, NULL, 5, 1, 0, 0},
    {0, 1012u, "ATS-Emergency-voltage-L3-N", "MPAC1500 old-map section 13; FC03 offset 6; read-only Emergency voltage L3-N. Controller-reported L-N voltage; site sensing/wiring qualification not established.", 5, 0, NULL, 6, 1, 0, 0},
    {0, 1013u, "ATS-Normal-voltage-L1-L2", "MPAC1500 old-map section 13; FC03 offset 7; read-only Normal voltage L1-L2.", 5, 0, NULL, 7, 1, 0, 0},
    {0, 1014u, "ATS-Normal-voltage-L2-L3", "MPAC1500 old-map section 13; FC03 offset 8; read-only Normal voltage L2-L3.", 5, 0, NULL, 8, 1, 0, 0},
    {0, 1015u, "ATS-Normal-voltage-L3-L1", "MPAC1500 old-map section 13; FC03 offset 9; read-only Normal voltage L3-L1.", 5, 0, NULL, 9, 1, 0, 0},
    {0, 1016u, "ATS-Emergency-voltage-L1-L2", "MPAC1500 old-map section 13; FC03 offset 10; read-only Emergency voltage L1-L2.", 5, 0, NULL, 10, 1, 0, 0},
    {0, 1017u, "ATS-Emergency-voltage-L2-L3", "MPAC1500 old-map section 13; FC03 offset 11; read-only Emergency voltage L2-L3.", 5, 0, NULL, 11, 1, 0, 0},
    {0, 1018u, "ATS-Emergency-voltage-L3-L1", "MPAC1500 old-map section 13; FC03 offset 12; read-only Emergency voltage L3-L1.", 5, 0, NULL, 12, 1, 0, 0},
    {0, 1019u, "ATS-Normal-frequency", "MPAC1500 old-map section 13; FC03 offset 13; read-only Normal frequency.", 27, 0, NULL, 13, 1, 0, 0},
    {0, 1020u, "ATS-Emergency-frequency", "MPAC1500 old-map section 13; FC03 offset 14; read-only Emergency frequency.", 27, 0, NULL, 14, 1, 0, 0},
    {0, 1021u, "ATS-Current-L1", "MPAC1500 old-map section 13; FC03 offset 15; read-only Current L1. CT/current sensing is unverified; readable values remain faulted.", 3, 0, NULL, 15, 1, 0, 0},
    {0, 1022u, "ATS-Current-L2", "MPAC1500 old-map section 13; FC03 offset 16; read-only Current L2. CT/current sensing is unverified; readable values remain faulted.", 3, 0, NULL, 16, 1, 0, 0},
    {0, 1023u, "ATS-Current-L3", "MPAC1500 old-map section 13; FC03 offset 17; read-only Current L3. CT/current sensing is unverified; readable values remain faulted.", 3, 0, NULL, 17, 1, 0, 0},
    {0, 1024u, "ATS-Closed-transition-phase-difference", "MPAC1500 old-map section 13; FC03 offset 18; read-only Closed-transition phase difference. Inter-source measurement requires qualified synchronization conditions; retain raw with qualification fault.", 90, 0, NULL, 18, 1, 0, 0},
    {0, 1025u, "ATS-Synchronous-phase-angle-register", "MPAC1500 old-map section 13; FC03 offset 40; read-only Synchronous phase-angle register. Inter-source measurement requires qualified synchronization conditions; retain raw with qualification fault.", 90, 0, NULL, 40, 1, 0, 0},
    {13, 1026u, "ATS-Normal-reported-phase-rotation", "MPAC1500 old-map section 13; FC03 offset 44; read-only Normal reported phase rotation. Reported code may be retained while source is unavailable.", 95, 4, states_1026, 44, 1, 8, 8},
    {13, 1027u, "ATS-Emergency-reported-phase-rotation", "MPAC1500 old-map section 13; FC03 offset 44; read-only Emergency reported phase rotation. Reported code may be retained while source is unavailable.", 95, 4, states_1027, 44, 1, 0, 8},
    {13, 1028u, "ATS-Expected-phase-rotation", "MPAC1500 old-map section 13; FC03 offset 45; read-only Expected phase rotation. Native setting is read-only through this gateway.", 95, 4, states_1028, 45, 1, 0, 0},
    {0, 1029u, "ATS-Nominal-normal-voltage", "MPAC1500 old-map section 13; FC03 offset 46; read-only Nominal normal voltage. Native setting is read-only through this gateway.", 5, 0, NULL, 46, 1, 0, 0},
    {0, 1030u, "ATS-Nominal-emergency-voltage", "MPAC1500 old-map section 13; FC03 offset 47; read-only Nominal emergency voltage. Native setting is read-only through this gateway.", 5, 0, NULL, 47, 1, 0, 0},
    {0, 1031u, "ATS-Nominal-normal-frequency", "MPAC1500 old-map section 13; FC03 offset 48; read-only Nominal normal frequency. Native setting is read-only through this gateway.", 27, 0, NULL, 48, 1, 0, 0},
    {0, 1032u, "ATS-Nominal-emergency-frequency", "MPAC1500 old-map section 13; FC03 offset 49; read-only Nominal emergency frequency. Native setting is read-only through this gateway.", 27, 0, NULL, 49, 1, 0, 0},
    {0, 1033u, "ATS-Normal-phase-count", "MPAC1500 old-map section 13; FC03 offset 50; read-only Normal phase count. Native setting is read-only through this gateway.", 95, 0, NULL, 50, 1, 0, 0},
    {0, 1034u, "ATS-Emergency-phase-count", "MPAC1500 old-map section 13; FC03 offset 51; read-only Emergency phase count. Native setting is read-only through this gateway.", 95, 0, NULL, 51, 1, 0, 0},
    {0, 1035u, "ATS-Rated-current", "MPAC1500 old-map section 13; FC03 offset 52; read-only Rated current. Native setting is read-only through this gateway.", 3, 0, NULL, 52, 1, 0, 0},
    {13, 1036u, "ATS-Transition-mode", "MPAC1500 old-map section 13; FC03 offset 56; read-only Transition mode. Native setting is read-only through this gateway.", 95, 5, states_1036, 56, 1, 0, 2},
    {13, 1037u, "ATS-Operating-mode", "MPAC1500 old-map section 13; FC03 offset 56; read-only Operating mode. Native setting is read-only through this gateway.", 95, 5, states_1037, 56, 1, 2, 2},
    {13, 1038u, "ATS-Supervised-transfer-switch", "MPAC1500 old-map section 13; FC03 offset 56; read-only Supervised transfer switch. Native setting is read-only through this gateway.", 95, 3, states_1038, 56, 1, 4, 1},
    {0, 1039u, "ATS-Active-delay-number", "MPAC1500 old-map section 13; FC03 offset 74; read-only Active delay number.", 95, 0, NULL, 74, 1, 0, 0},
    {0, 1040u, "ATS-Active-delay-remaining", "MPAC1500 old-map section 13; FC03 offset 75; read-only Active delay remaining.", 73, 0, NULL, 75, 1, 0, 0},
    {0, 1041u, "ATS-Active-delay-preset", "MPAC1500 old-map section 13; FC03 offset 76; read-only Active delay preset.", 73, 0, NULL, 76, 1, 0, 0},
    {0, 1042u, "ATS-Normal-engine-start-delay", "MPAC1500 old-map section 13; FC03 offset 58; read-only Normal engine-start delay. Native setting is read-only through this gateway.", 73, 0, NULL, 58, 1, 0, 0},
    {0, 1043u, "ATS-Emergency-engine-start-delay", "MPAC1500 old-map section 13; FC03 offset 59; read-only Emergency engine-start delay. Native setting is read-only through this gateway.", 73, 0, NULL, 59, 1, 0, 0},
    {0, 1044u, "ATS-Normal-extended-engine-start-delay", "MPAC1500 old-map section 13; FC03 offset 60; read-only Normal extended engine-start delay. Native setting is read-only through this gateway.", 73, 0, NULL, 60, 1, 0, 0},
    {0, 1045u, "ATS-Emergency-extended-engine-start-delay", "MPAC1500 old-map section 13; FC03 offset 61; read-only Emergency extended engine-start delay. Native setting is read-only through this gateway.", 73, 0, NULL, 61, 1, 0, 0},
    {0, 1046u, "ATS-Normal-engine-cooldown", "MPAC1500 old-map section 13; FC03 offset 62; read-only Normal engine cooldown. Native setting is read-only through this gateway.", 73, 0, NULL, 62, 1, 0, 0},
    {0, 1047u, "ATS-Emergency-engine-cooldown", "MPAC1500 old-map section 13; FC03 offset 63; read-only Emergency engine cooldown. Native setting is read-only through this gateway.", 73, 0, NULL, 63, 1, 0, 0},
    {0, 1048u, "ATS-Standby-to-preferred-delay", "MPAC1500 old-map section 13; FC03 offset 64; read-only Standby-to-preferred delay. Native setting is read-only through this gateway.", 73, 0, NULL, 64, 1, 0, 0},
    {0, 1049u, "ATS-Preferred-to-standby-delay", "MPAC1500 old-map section 13; FC03 offset 65; read-only Preferred-to-standby delay. Native setting is read-only through this gateway.", 73, 0, NULL, 65, 1, 0, 0},
    {0, 1050u, "ATS-Off-delay-preferred-to-standby", "MPAC1500 old-map section 13; FC03 offset 66; read-only Off delay preferred-to-standby. Native setting is read-only through this gateway.", 73, 0, NULL, 66, 1, 0, 0},
    {0, 1051u, "ATS-Off-delay-standby-to-preferred", "MPAC1500 old-map section 13; FC03 offset 67; read-only Off delay standby-to-preferred. Native setting is read-only through this gateway.", 73, 0, NULL, 67, 1, 0, 0},
    {0, 1052u, "ATS-Fail-to-acquire-preferred-delay", "MPAC1500 old-map section 13; FC03 offset 68; read-only Fail-to-acquire preferred delay. Native setting is read-only through this gateway.", 73, 0, NULL, 68, 1, 0, 0},
    {0, 1053u, "ATS-Fail-to-acquire-standby-delay", "MPAC1500 old-map section 13; FC03 offset 69; read-only Fail-to-acquire standby delay. Native setting is read-only through this gateway.", 73, 0, NULL, 69, 1, 0, 0},
    {0, 1054u, "ATS-Fail-to-synchronize-delay", "MPAC1500 old-map section 13; FC03 offset 70; read-only Fail-to-synchronize delay. Native setting is read-only through this gateway.", 73, 0, NULL, 70, 1, 0, 0},
    {3, 1055u, "ATS-Fail-to-synchronize-enabled", "MPAC1500 old-map section 13; FC03 offset 71; read-only Fail-to-synchronize enabled. Native setting is read-only through this gateway.", 95, 0, NULL, 71, 1, 0, 1},
    {0, 1056u, "ATS-Normal-overvoltage-dropout", "MPAC1500 old-map section 13; FC03 offset 77; read-only Normal overvoltage dropout. Native setting is read-only through this gateway. Percent denominator: nominal. Configuration threshold, not a live alarm.", 98, 0, NULL, 77, 1, 0, 0},
    {0, 1057u, "ATS-Normal-overvoltage-pickup", "MPAC1500 old-map section 13; FC03 offset 78; read-only Normal overvoltage pickup. Native setting is read-only through this gateway. Percent denominator: nominal. Configuration threshold, not a live alarm.", 98, 0, NULL, 78, 1, 0, 0},
    {0, 1058u, "ATS-Normal-undervoltage-pickup", "MPAC1500 old-map section 13; FC03 offset 79; read-only Normal undervoltage pickup. Native setting is read-only through this gateway. Percent denominator: nominal. Configuration threshold, not a live alarm.", 98, 0, NULL, 79, 1, 0, 0},
    {0, 1059u, "ATS-Normal-undervoltage-dropout", "MPAC1500 old-map section 13; FC03 offset 80; read-only Normal undervoltage dropout. Native setting is read-only through this gateway. Percent denominator: pickup. Configuration threshold, not a live alarm.", 98, 0, NULL, 80, 1, 0, 0},
    {3, 1060u, "ATS-Normal-voltage-unbalance-enabled", "MPAC1500 old-map section 13; FC03 offset 81; read-only Normal voltage unbalance enabled. Native setting is read-only through this gateway. Configuration threshold, not a live alarm.", 95, 0, NULL, 81, 1, 0, 0},
    {0, 1061u, "ATS-Normal-voltage-unbalance-dropout", "MPAC1500 old-map section 13; FC03 offset 82; read-only Normal voltage unbalance dropout. Native setting is read-only through this gateway. Configuration threshold, not a live alarm.", 98, 0, NULL, 82, 1, 0, 0},
    {0, 1062u, "ATS-Normal-voltage-unbalance-pickup", "MPAC1500 old-map section 13; FC03 offset 83; read-only Normal voltage unbalance pickup. Native setting is read-only through this gateway. Configuration threshold, not a live alarm.", 98, 0, NULL, 83, 1, 0, 0},
    {0, 1063u, "ATS-Normal-voltage-debounce-time", "MPAC1500 old-map section 13; FC03 offset 84; read-only Normal voltage debounce time. Native setting is read-only through this gateway. Configuration threshold, not a live alarm.", 73, 0, NULL, 84, 1, 0, 0},
    {0, 1064u, "ATS-Emergency-overvoltage-dropout", "MPAC1500 old-map section 13; FC03 offset 85; read-only Emergency overvoltage dropout. Native setting is read-only through this gateway. Percent denominator: nominal. Configuration threshold, not a live alarm.", 98, 0, NULL, 85, 1, 0, 0},
    {0, 1065u, "ATS-Emergency-overvoltage-pickup", "MPAC1500 old-map section 13; FC03 offset 86; read-only Emergency overvoltage pickup. Native setting is read-only through this gateway. Percent denominator: nominal. Configuration threshold, not a live alarm.", 98, 0, NULL, 86, 1, 0, 0},
    {0, 1066u, "ATS-Emergency-undervoltage-pickup", "MPAC1500 old-map section 13; FC03 offset 87; read-only Emergency undervoltage pickup. Native setting is read-only through this gateway. Percent denominator: nominal. Configuration threshold, not a live alarm.", 98, 0, NULL, 87, 1, 0, 0},
    {0, 1067u, "ATS-Emergency-undervoltage-dropout", "MPAC1500 old-map section 13; FC03 offset 88; read-only Emergency undervoltage dropout. Native setting is read-only through this gateway. Percent denominator: pickup. Configuration threshold, not a live alarm.", 98, 0, NULL, 88, 1, 0, 0},
    {3, 1068u, "ATS-Emergency-voltage-unbalance-enabled", "MPAC1500 old-map section 13; FC03 offset 89; read-only Emergency voltage unbalance enabled. Native setting is read-only through this gateway. Configuration threshold, not a live alarm.", 95, 0, NULL, 89, 1, 0, 0},
    {0, 1069u, "ATS-Emergency-voltage-unbalance-dropout", "MPAC1500 old-map section 13; FC03 offset 90; read-only Emergency voltage unbalance dropout. Native setting is read-only through this gateway. Configuration threshold, not a live alarm.", 98, 0, NULL, 90, 1, 0, 0},
    {0, 1070u, "ATS-Emergency-voltage-unbalance-pickup", "MPAC1500 old-map section 13; FC03 offset 91; read-only Emergency voltage unbalance pickup. Native setting is read-only through this gateway. Configuration threshold, not a live alarm.", 98, 0, NULL, 91, 1, 0, 0},
    {0, 1071u, "ATS-Emergency-voltage-debounce-time", "MPAC1500 old-map section 13; FC03 offset 92; read-only Emergency voltage debounce time. Native setting is read-only through this gateway. Configuration threshold, not a live alarm.", 73, 0, NULL, 92, 1, 0, 0},
    {0, 1072u, "ATS-Normal-overfrequency-dropout", "MPAC1500 old-map section 13; FC03 offset 93; read-only Normal overfrequency dropout. Native setting is read-only through this gateway. Percent denominator: pickup. Configuration threshold, not a live alarm.", 98, 0, NULL, 93, 1, 0, 0},
    {0, 1073u, "ATS-Normal-overfrequency-pickup", "MPAC1500 old-map section 13; FC03 offset 94; read-only Normal overfrequency pickup. Native setting is read-only through this gateway. Percent denominator: nominal. Configuration threshold, not a live alarm.", 98, 0, NULL, 94, 1, 0, 0},
    {0, 1074u, "ATS-Normal-underfrequency-dropout", "MPAC1500 old-map section 13; FC03 offset 95; read-only Normal underfrequency dropout. Native setting is read-only through this gateway. Percent denominator: pickup. Configuration threshold, not a live alarm.", 98, 0, NULL, 95, 1, 0, 0},
    {0, 1075u, "ATS-Normal-underfrequency-pickup", "MPAC1500 old-map section 13; FC03 offset 96; read-only Normal underfrequency pickup. Native setting is read-only through this gateway. Percent denominator: nominal. Configuration threshold, not a live alarm.", 98, 0, NULL, 96, 1, 0, 0},
    {0, 1076u, "ATS-Normal-frequency-dropout-time", "MPAC1500 old-map section 13; FC03 offset 97; read-only Normal frequency dropout time. Native setting is read-only through this gateway. Configuration threshold, not a live alarm.", 73, 0, NULL, 97, 1, 0, 0},
    {0, 1077u, "ATS-Emergency-overfrequency-dropout", "MPAC1500 old-map section 13; FC03 offset 98; read-only Emergency overfrequency dropout. Native setting is read-only through this gateway. Percent denominator: pickup. Configuration threshold, not a live alarm.", 98, 0, NULL, 98, 1, 0, 0},
    {0, 1078u, "ATS-Emergency-overfrequency-pickup", "MPAC1500 old-map section 13; FC03 offset 99; read-only Emergency overfrequency pickup. Native setting is read-only through this gateway. Percent denominator: nominal. Configuration threshold, not a live alarm.", 98, 0, NULL, 99, 1, 0, 0},
    {0, 1079u, "ATS-Emergency-underfrequency-dropout", "MPAC1500 old-map section 13; FC03 offset 100; read-only Emergency underfrequency dropout. Native setting is read-only through this gateway. Percent denominator: pickup. Configuration threshold, not a live alarm.", 98, 0, NULL, 100, 1, 0, 0},
    {0, 1080u, "ATS-Emergency-underfrequency-pickup", "MPAC1500 old-map section 13; FC03 offset 101; read-only Emergency underfrequency pickup. Native setting is read-only through this gateway. Percent denominator: nominal. Configuration threshold, not a live alarm.", 98, 0, NULL, 101, 1, 0, 0},
    {0, 1081u, "ATS-Emergency-frequency-dropout-time", "MPAC1500 old-map section 13; FC03 offset 102; read-only Emergency frequency dropout time. Native setting is read-only through this gateway. Configuration threshold, not a live alarm.", 73, 0, NULL, 102, 1, 0, 0},
    {13, 1082u, "ATS-Expansion-board-1-type", "MPAC1500 old-map section 13; FC03 offset 153; read-only Expansion board 1 type.", 95, 4, states_1082, 153, 1, 0, 0},
    {13, 1083u, "ATS-Expansion-board-2-type", "MPAC1500 old-map section 13; FC03 offset 154; read-only Expansion board 2 type.", 95, 4, states_1083, 154, 1, 0, 0},
    {13, 1084u, "ATS-Expansion-board-3-type", "MPAC1500 old-map section 13; FC03 offset 155; read-only Expansion board 3 type.", 95, 4, states_1084, 155, 1, 0, 0},
    {13, 1085u, "ATS-Expansion-board-4-type", "MPAC1500 old-map section 13; FC03 offset 156; read-only Expansion board 4 type.", 95, 4, states_1085, 156, 1, 0, 0},
    {13, 1086u, "ATS-Alarm-option-board", "MPAC1500 old-map section 13; FC03 offset 159; read-only Alarm option board.", 95, 5, states_1086, 159, 1, 0, 0},
    {3, 1087u, "ATS-Battery-option-board-installed", "MPAC1500 old-map section 13; FC03 offset 160; read-only Battery option board installed.", 95, 0, NULL, 160, 1, 0, 1},
    {3, 1088u, "ATS-Main-board-output-1", "MPAC1500 old-map section 13; FC03 offset 193; read-only Main board output 1. Electrical state only; configured function is not established.", 95, 0, NULL, 193, 1, 0, 1},
    {3, 1089u, "ATS-Main-board-output-2", "MPAC1500 old-map section 13; FC03 offset 193; read-only Main board output 2. Electrical state only; configured function is not established.", 95, 0, NULL, 193, 1, 1, 1},
    {3, 1090u, "ATS-Main-board-input-1", "MPAC1500 old-map section 13; FC03 offset 194; read-only Main board input 1. Electrical state only; configured function is not established.", 95, 0, NULL, 194, 1, 0, 1},
    {3, 1091u, "ATS-Main-board-input-2", "MPAC1500 old-map section 13; FC03 offset 194; read-only Main board input 2. Electrical state only; configured function is not established.", 95, 0, NULL, 194, 1, 1, 1},
    {0, 1092u, "ATS-Expansion-board-1-outputs-bitmap", "MPAC1500 old-map section 13; FC03 offset 195; read-only Expansion board 1 outputs bitmap. Meaning requires corresponding installed expansion board; absent boards are not applicable.", 95, 0, NULL, 195, 1, 0, 0},
    {0, 1093u, "ATS-Expansion-board-2-outputs-bitmap", "MPAC1500 old-map section 13; FC03 offset 196; read-only Expansion board 2 outputs bitmap. Meaning requires corresponding installed expansion board; absent boards are not applicable.", 95, 0, NULL, 196, 1, 0, 0},
    {0, 1094u, "ATS-Expansion-board-3-outputs-bitmap", "MPAC1500 old-map section 13; FC03 offset 197; read-only Expansion board 3 outputs bitmap. Meaning requires corresponding installed expansion board; absent boards are not applicable.", 95, 0, NULL, 197, 1, 0, 0},
    {0, 1095u, "ATS-Expansion-board-4-outputs-bitmap", "MPAC1500 old-map section 13; FC03 offset 198; read-only Expansion board 4 outputs bitmap. Meaning requires corresponding installed expansion board; absent boards are not applicable.", 95, 0, NULL, 198, 1, 0, 0},
    {0, 1096u, "ATS-Expansion-board-1-inputs-bitmap", "MPAC1500 old-map section 13; FC03 offset 199; read-only Expansion board 1 inputs bitmap. Meaning requires corresponding installed expansion board; absent boards are not applicable.", 95, 0, NULL, 199, 1, 0, 0},
    {0, 1097u, "ATS-Expansion-board-2-inputs-bitmap", "MPAC1500 old-map section 13; FC03 offset 200; read-only Expansion board 2 inputs bitmap. Meaning requires corresponding installed expansion board; absent boards are not applicable.", 95, 0, NULL, 200, 1, 0, 0},
    {0, 1098u, "ATS-Expansion-board-3-inputs-bitmap", "MPAC1500 old-map section 13; FC03 offset 201; read-only Expansion board 3 inputs bitmap. Meaning requires corresponding installed expansion board; absent boards are not applicable.", 95, 0, NULL, 201, 1, 0, 0},
    {0, 1099u, "ATS-Expansion-board-4-inputs-bitmap", "MPAC1500 old-map section 13; FC03 offset 202; read-only Expansion board 4 inputs bitmap. Meaning requires corresponding installed expansion board; absent boards are not applicable.", 95, 0, NULL, 202, 1, 0, 0},
    {0, 1100u, "ATS-Software-output-state-bitmap", "MPAC1500 old-map section 13; FC03 offset 249; read-only Software output state bitmap. Native setting is read-only through this gateway. Raw logical state; no assigned functions means not applicable.", 95, 0, NULL, 249, 1, 0, 0},
    {0, 1101u, "ATS-Software-output-assignment-bitmap", "MPAC1500 old-map section 13; FC03 offset 250; read-only Software output assignment bitmap.", 95, 0, NULL, 250, 1, 0, 0},
    {0, 1102u, "ATS-Remote-monitored-input-state-bitmap", "MPAC1500 old-map section 13; FC03 offset 251; read-only Remote monitored input state bitmap. Raw logical state; no assigned functions means not applicable.", 95, 0, NULL, 251, 1, 0, 0},
    {0, 1103u, "ATS-Remote-monitored-input-assignment-bitmap", "MPAC1500 old-map section 13; FC03 offset 252; read-only Remote monitored input assignment bitmap.", 95, 0, NULL, 252, 1, 0, 0},
    {0, 1104u, "ATS-Accessory-setup-raw", "MPAC1500 old-map section 13; FC03 offset 739; read-only Accessory setup raw. Native setting is read-only through this gateway.", 95, 0, NULL, 739, 1, 0, 0},
    {3, 1105u, "ATS-Exercise-in-progress", "MPAC1500 old-map section 13; FC03 offset 741; read-only Exercise in progress.", 95, 0, NULL, 741, 1, 0, 1},
    {3, 1106u, "ATS-In-phase-monitor-active", "MPAC1500 old-map section 13; FC03 offset 741; read-only In-phase monitor active.", 95, 0, NULL, 741, 1, 1, 1},
    {3, 1107u, "ATS-Load-control-in-progress", "MPAC1500 old-map section 13; FC03 offset 741; read-only Load control in progress.", 95, 0, NULL, 741, 1, 2, 1},
    {3, 1108u, "ATS-Peak-shaving-in-progress", "MPAC1500 old-map section 13; FC03 offset 741; read-only Peak shaving in progress.", 95, 0, NULL, 741, 1, 3, 1},
    {3, 1109u, "ATS-Loaded-test-in-progress", "MPAC1500 old-map section 13; FC03 offset 741; read-only Loaded test in progress.", 95, 0, NULL, 741, 1, 4, 1},
    {3, 1110u, "ATS-Unloaded-test-in-progress", "MPAC1500 old-map section 13; FC03 offset 741; read-only Unloaded test in progress.", 95, 0, NULL, 741, 1, 5, 1},
    {3, 1111u, "ATS-Auto-loaded-test-in-progress", "MPAC1500 old-map section 13; FC03 offset 741; read-only Auto-loaded test in progress.", 95, 0, NULL, 741, 1, 6, 1},
    {3, 1112u, "ATS-Maintenance-mode-DIP-switch", "MPAC1500 old-map section 13; FC03 offset 742; read-only Maintenance mode DIP switch.", 95, 0, NULL, 742, 1, 0, 1},
    {3, 1113u, "ATS-Password-disabled-DIP-switch", "MPAC1500 old-map section 13; FC03 offset 742; read-only Password-disabled DIP switch.", 95, 0, NULL, 742, 1, 1, 1},
    {3, 1114u, "ATS-Next-exercise-enabled", "MPAC1500 old-map section 13; FC03 offset 904; read-only Next exercise enabled. Native setting is read-only through this gateway.", 95, 0, NULL, 904, 1, 0, 1},
    {3, 1115u, "ATS-Next-exercise-loaded", "MPAC1500 old-map section 13; FC03 offset 904; read-only Next exercise loaded. Native setting is read-only through this gateway.", 95, 0, NULL, 904, 1, 1, 1},
    {13, 1116u, "ATS-Next-exercise-interval", "MPAC1500 old-map section 13; FC03 offset 904; read-only Next exercise interval. Native setting is read-only through this gateway.", 95, 5, states_1116, 904, 1, 2, 2},
    {0, 1117u, "ATS-Next-exercise-repeat-rate", "MPAC1500 old-map section 13; FC03 offset 904; read-only Next exercise repeat rate. Native setting is read-only through this gateway.", 95, 0, NULL, 904, 1, 4, 4},
    {3, 1118u, "ATS-Next-exercise-running", "MPAC1500 old-map section 13; FC03 offset 904; read-only Next exercise running.", 95, 0, NULL, 904, 1, 8, 1},
    {40, 1119u, "ATS-Next-exercise-start-time", "MPAC1500 old-map section 13; FC03 offset 905; read-only Next exercise start time. Native setting is read-only through this gateway. Controller local calendar/clock; no timezone or UTC inference.", 95, 0, NULL, 905, 1, 0, 0},
    {40, 1120u, "ATS-Next-exercise-start-date", "MPAC1500 old-map section 13; FC03 offset 906; read-only Next exercise start date. Native setting is read-only through this gateway. Controller local calendar/clock; no timezone or UTC inference.", 95, 0, NULL, 906, 1, 0, 0},
    {0, 1121u, "ATS-Next-exercise-duration", "MPAC1500 old-map section 13; FC03 offset 907; read-only Next exercise duration. Native setting is read-only through this gateway.", 72, 0, NULL, 907, 1, 0, 0},
    {3, 1122u, "ATS-Exercise-schedule-1-enabled", "MPAC1500 old-map section 13; FC03 offset 909; read-only Exercise schedule 1 enabled. Native setting is read-only through this gateway.", 95, 0, NULL, 909, 1, 0, 1},
    {3, 1123u, "ATS-Exercise-schedule-1-loaded", "MPAC1500 old-map section 13; FC03 offset 909; read-only Exercise schedule 1 loaded. Native setting is read-only through this gateway.", 95, 0, NULL, 909, 1, 1, 1},
    {13, 1124u, "ATS-Exercise-schedule-1-interval", "MPAC1500 old-map section 13; FC03 offset 909; read-only Exercise schedule 1 interval. Native setting is read-only through this gateway.", 95, 5, states_1124, 909, 1, 2, 2},
    {0, 1125u, "ATS-Exercise-schedule-1-repeat-rate", "MPAC1500 old-map section 13; FC03 offset 909; read-only Exercise schedule 1 repeat rate. Native setting is read-only through this gateway.", 95, 0, NULL, 909, 1, 4, 4},
    {3, 1126u, "ATS-Exercise-schedule-1-running", "MPAC1500 old-map section 13; FC03 offset 909; read-only Exercise schedule 1 running.", 95, 0, NULL, 909, 1, 8, 1},
    {40, 1127u, "ATS-Exercise-schedule-1-start-time", "MPAC1500 old-map section 13; FC03 offset 910; read-only Exercise schedule 1 start time. Native setting is read-only through this gateway. Controller local calendar/clock; no timezone or UTC inference.", 95, 0, NULL, 910, 1, 0, 0},
    {40, 1128u, "ATS-Exercise-schedule-1-start-date", "MPAC1500 old-map section 13; FC03 offset 911; read-only Exercise schedule 1 start date. Native setting is read-only through this gateway. Controller local calendar/clock; no timezone or UTC inference.", 95, 0, NULL, 911, 1, 0, 0},
    {0, 1129u, "ATS-Exercise-schedule-1-duration", "MPAC1500 old-map section 13; FC03 offset 912; read-only Exercise schedule 1 duration. Native setting is read-only through this gateway.", 72, 0, NULL, 912, 1, 0, 0},
    {40, 1130u, "ATS-Last-outage-start-time", "MPAC1500 old-map section 13; FC03 offset 1009; read-only Last outage start time. Controller local calendar/clock; no timezone or UTC inference.", 95, 0, NULL, 1009, 1, 0, 0},
    {40, 1131u, "ATS-Last-outage-date", "MPAC1500 old-map section 13; FC03 offset 1010; read-only Last outage date. Controller local calendar/clock; no timezone or UTC inference.", 95, 0, NULL, 1010, 1, 0, 0},
    {0, 1132u, "ATS-Last-outage-duration", "MPAC1500 old-map section 13; FC03 offset 1011; read-only Last outage duration. MSW-first duration word order is unverified; raw pair retained.", 72, 0, NULL, 1011, 2, 0, 0},
    {40, 1133u, "ATS-ATS-designation", "MPAC1500 old-map section 13; FC03 offset 1109; read-only ATS designation. Native setting is read-only through this gateway. Observed firmware uses low-byte-first characters within each word; numeric word order is unchanged.", 95, 0, NULL, 1109, 10, 0, 0},
    {40, 1134u, "ATS-Load-description", "MPAC1500 old-map section 13; FC03 offset 1119; read-only Load description. Native setting is read-only through this gateway. Observed firmware uses low-byte-first characters within each word; numeric word order is unchanged.", 95, 0, NULL, 1119, 10, 0, 0},
    {40, 1135u, "ATS-Branch-description", "MPAC1500 old-map section 13; FC03 offset 1129; read-only Branch description. Native setting is read-only through this gateway. Observed firmware uses low-byte-first characters within each word; numeric word order is unchanged.", 95, 0, NULL, 1129, 10, 0, 0},
    {40, 1136u, "ATS-Location", "MPAC1500 old-map section 13; FC03 offset 1139; read-only Location. Native setting is read-only through this gateway. Observed firmware uses low-byte-first characters within each word; numeric word order is unchanged.", 95, 0, NULL, 1139, 10, 0, 0},
    {40, 1137u, "ATS-Controller-firmware", "MPAC1500 old-map section 13; FC03 offset 1199; read-only Controller firmware.", 95, 0, NULL, 1199, 1, 0, 0},
    {0, 1138u, "ATS-FPGA-revision-raw", "MPAC1500 old-map section 13; FC03 offset 1200; read-only FPGA revision raw. Only low byte minor version is documented; upper byte remains raw.", 95, 0, NULL, 1200, 1, 0, 0},
    {0, 1139u, "ATS-MAC-low-15-bits", "MPAC1500 old-map section 13; FC03 offset 1201; read-only MAC low 15 bits. Old-map low-15-bit identity fingerprint only; do not use on newer map.", 95, 0, NULL, 1201, 1, 0, 0},
    {40, 1140u, "ATS-Controller-time", "MPAC1500 old-map section 13; FC03 offset 1249; read-only Controller time. Native setting is read-only through this gateway. Controller local calendar/clock; no timezone or UTC inference.", 95, 0, NULL, 1249, 1, 0, 0},
    {40, 1141u, "ATS-Controller-date", "MPAC1500 old-map section 13; FC03 offset 1250; read-only Controller date. Native setting is read-only through this gateway. Controller local calendar/clock; no timezone or UTC inference.", 95, 0, NULL, 1250, 1, 0, 0},
    {3, 1142u, "ATS-Daylight-saving-adjustment-enabled", "MPAC1500 old-map section 13; FC03 offset 1251; read-only Daylight-saving adjustment enabled. Native setting is read-only through this gateway.", 95, 0, NULL, 1251, 1, 0, 1},
    {0, 1143u, "ATS-Closed-transition-parallel-time", "MPAC1500 old-map section 13; FC03 offset 1294; read-only Closed-transition parallel time.", 159, 0, NULL, 1294, 1, 0, 0},
    {0, 1144u, "ATS-Normal-contact-opening-time", "MPAC1500 old-map section 13; FC03 offset 1295; read-only Normal contact opening time.", 159, 0, NULL, 1295, 1, 0, 0},
    {0, 1145u, "ATS-Normal-contact-closing-time", "MPAC1500 old-map section 13; FC03 offset 1296; read-only Normal contact closing time.", 159, 0, NULL, 1296, 1, 0, 0},
    {0, 1146u, "ATS-Emergency-contact-opening-time", "MPAC1500 old-map section 13; FC03 offset 1297; read-only Emergency contact opening time.", 159, 0, NULL, 1297, 1, 0, 0},
    {0, 1147u, "ATS-Emergency-contact-closing-time", "MPAC1500 old-map section 13; FC03 offset 1298; read-only Emergency contact closing time.", 159, 0, NULL, 1298, 1, 0, 0},
    {0, 1148u, "ATS-Time-outside-preferred-source-total", "MPAC1500 old-map section 13; FC03 offset 1299; read-only Time outside preferred source total. ATS controller minutes, not generator engine runtime.", 72, 0, NULL, 1299, 2, 0, 0},
    {0, 1149u, "ATS-Time-outside-preferred-source-since-reset", "MPAC1500 old-map section 13; FC03 offset 1301; read-only Time outside preferred source since reset. ATS controller minutes, not generator engine runtime.", 72, 0, NULL, 1301, 2, 0, 0},
    {0, 1150u, "ATS-Time-on-standby-total", "MPAC1500 old-map section 13; FC03 offset 1303; read-only Time on standby total. ATS controller minutes, not generator engine runtime.", 72, 0, NULL, 1303, 2, 0, 0},
    {0, 1151u, "ATS-Time-on-standby-since-reset", "MPAC1500 old-map section 13; FC03 offset 1305; read-only Time on standby since reset. ATS controller minutes, not generator engine runtime.", 72, 0, NULL, 1305, 2, 0, 0},
    {0, 1152u, "ATS-Operating-time-total", "MPAC1500 old-map section 13; FC03 offset 1307; read-only Operating time total. ATS controller minutes, not generator engine runtime.", 72, 0, NULL, 1307, 2, 0, 0},
    {0, 1153u, "ATS-Operating-time-since-reset", "MPAC1500 old-map section 13; FC03 offset 1309; read-only Operating time since reset. ATS controller minutes, not generator engine runtime.", 72, 0, NULL, 1309, 2, 0, 0},
    {0, 1154u, "ATS-Transfer-count-total", "MPAC1500 old-map section 13; FC03 offset 1311; read-only Transfer count total.", 95, 0, NULL, 1311, 1, 0, 0},
    {0, 1155u, "ATS-Transfer-count-since-reset", "MPAC1500 old-map section 13; FC03 offset 1312; read-only Transfer count since reset.", 95, 0, NULL, 1312, 1, 0, 0},
    {0, 1156u, "ATS-Failed-transfer-count-total", "MPAC1500 old-map section 13; FC03 offset 1313; read-only Failed transfer count total.", 95, 0, NULL, 1313, 1, 0, 0},
    {0, 1157u, "ATS-Failed-transfer-count-since-reset", "MPAC1500 old-map section 13; FC03 offset 1314; read-only Failed transfer count since reset.", 95, 0, NULL, 1314, 1, 0, 0},
    {0, 1158u, "ATS-Loss-of-preferred-transfer-count-total", "MPAC1500 old-map section 13; FC03 offset 1315; read-only Loss-of-preferred transfer count total.", 95, 0, NULL, 1315, 1, 0, 0},
    {0, 1159u, "ATS-Loss-of-preferred-transfer-count-since-reset", "MPAC1500 old-map section 13; FC03 offset 1316; read-only Loss-of-preferred transfer count since reset.", 95, 0, NULL, 1316, 1, 0, 0},
    {0, 1160u, "ATS-Normal-to-emergency-transfer-time", "MPAC1500 old-map section 13; FC03 offset 1317; read-only Normal-to-emergency transfer time.", 159, 0, NULL, 1317, 1, 0, 0},
    {0, 1161u, "ATS-Emergency-to-normal-transfer-time", "MPAC1500 old-map section 13; FC03 offset 1318; read-only Emergency-to-normal transfer time.", 159, 0, NULL, 1318, 1, 0, 0},
    {40, 1162u, "ATS-Last-maintenance-date", "MPAC1500 old-map section 13; FC03 offset 1319; read-only Last maintenance date. Controller local calendar/clock; no timezone or UTC inference. Stored date, not proof of maintenance; known default 2001-01-01 is unverified.", 95, 0, NULL, 1319, 1, 0, 0},
    {0, 1163u, "ATS-Keypress-state-bitmap", "MPAC1500 old-map section 13; FC03 offset 3449; read-only Keypress state bitmap.", 95, 0, NULL, 3449, 1, 0, 0},
    {0, 1164u, "ATS-Modbus-device-type", "MPAC1500 old-map section 13; FC03 offset 9998; read-only Modbus device type.", 95, 0, NULL, 9998, 1, 0, 0},
};

static const point_decode_t point_decoders[ATS_POINT_COUNT] = {
    {ENC_U16, 1, 1},
    {ENC_ENUM, 1, 1},
    {ENC_ENUM, 1, 1},
    {ENC_U16, 1, 1},
    {ENC_BOOL, 1, 1},
    {ENC_BOOL, 1, 1},
    {ENC_U16, 1, 10},
    {ENC_U16, 1, 10},
    {ENC_U16, 1, 10},
    {ENC_U16, 1, 10},
    {ENC_U16, 1, 10},
    {ENC_U16, 1, 10},
    {ENC_U16, 1, 10},
    {ENC_U16, 1, 10},
    {ENC_U16, 1, 10},
    {ENC_U16, 1, 10},
    {ENC_U16, 1, 10},
    {ENC_U16, 1, 10},
    {ENC_U16, 1, 10},
    {ENC_U16, 1, 10},
    {ENC_U16, 1, 10},
    {ENC_U16, 1, 10},
    {ENC_U16, 1, 10},
    {ENC_U16, 1, 1},
    {ENC_U16, 1, 1},
    {ENC_ENUM, 1, 1},
    {ENC_ENUM, 1, 1},
    {ENC_ENUM, 1, 1},
    {ENC_U16, 1, 10},
    {ENC_U16, 1, 10},
    {ENC_U16, 1, 10},
    {ENC_U16, 1, 10},
    {ENC_U16, 1, 1},
    {ENC_U16, 1, 1},
    {ENC_U16, 1, 1},
    {ENC_ENUM, 1, 1},
    {ENC_ENUM, 1, 1},
    {ENC_ENUM, 1, 1},
    {ENC_U16, 1, 1},
    {ENC_U16, 1, 10},
    {ENC_U16, 1, 10},
    {ENC_U16, 1, 1},
    {ENC_U16, 1, 1},
    {ENC_U16, 1, 1},
    {ENC_U16, 1, 1},
    {ENC_U16, 1, 1},
    {ENC_U16, 1, 1},
    {ENC_U16, 1, 1},
    {ENC_U16, 1, 1},
    {ENC_U16, 1, 1},
    {ENC_U16, 1, 1},
    {ENC_U16, 1, 1},
    {ENC_U16, 1, 1},
    {ENC_U16, 1, 1},
    {ENC_BOOL, 1, 1},
    {ENC_U16, 1, 1},
    {ENC_U16, 1, 1},
    {ENC_U16, 1, 1},
    {ENC_U16, 1, 1},
    {ENC_BOOL, 1, 1},
    {ENC_U16, 1, 1},
    {ENC_U16, 1, 1},
    {ENC_U16, 1, 10},
    {ENC_U16, 1, 1},
    {ENC_U16, 1, 1},
    {ENC_U16, 1, 1},
    {ENC_U16, 1, 1},
    {ENC_BOOL, 1, 1},
    {ENC_U16, 1, 1},
    {ENC_U16, 1, 1},
    {ENC_U16, 1, 10},
    {ENC_U16, 1, 1},
    {ENC_U16, 1, 1},
    {ENC_U16, 1, 1},
    {ENC_U16, 1, 1},
    {ENC_U16, 1, 10},
    {ENC_U16, 1, 1},
    {ENC_U16, 1, 1},
    {ENC_U16, 1, 1},
    {ENC_U16, 1, 1},
    {ENC_U16, 1, 10},
    {ENC_ENUM, 1, 1},
    {ENC_ENUM, 1, 1},
    {ENC_ENUM, 1, 1},
    {ENC_ENUM, 1, 1},
    {ENC_ENUM, 1, 1},
    {ENC_BOOL, 1, 1},
    {ENC_BOOL, 1, 1},
    {ENC_BOOL, 1, 1},
    {ENC_BOOL, 1, 1},
    {ENC_BOOL, 1, 1},
    {ENC_U16, 1, 1},
    {ENC_U16, 1, 1},
    {ENC_U16, 1, 1},
    {ENC_U16, 1, 1},
    {ENC_U16, 1, 1},
    {ENC_U16, 1, 1},
    {ENC_U16, 1, 1},
    {ENC_U16, 1, 1},
    {ENC_U16, 1, 1},
    {ENC_U16, 1, 1},
    {ENC_U16, 1, 1},
    {ENC_U16, 1, 1},
    {ENC_U16, 1, 1},
    {ENC_BOOL, 1, 1},
    {ENC_BOOL, 1, 1},
    {ENC_BOOL, 1, 1},
    {ENC_BOOL, 1, 1},
    {ENC_BOOL, 1, 1},
    {ENC_BOOL, 1, 1},
    {ENC_BOOL, 1, 1},
    {ENC_BOOL, 1, 1},
    {ENC_BOOL, 1, 1},
    {ENC_BOOL, 1, 1},
    {ENC_BOOL, 1, 1},
    {ENC_ENUM, 1, 1},
    {ENC_U16, 1, 1},
    {ENC_BOOL, 1, 1},
    {ENC_CLOCK, 1, 1},
    {ENC_DATE, 1, 1},
    {ENC_U16, 1, 1},
    {ENC_BOOL, 1, 1},
    {ENC_BOOL, 1, 1},
    {ENC_ENUM, 1, 1},
    {ENC_U16, 1, 1},
    {ENC_BOOL, 1, 1},
    {ENC_CLOCK, 1, 1},
    {ENC_DATE, 1, 1},
    {ENC_U16, 1, 1},
    {ENC_CLOCK, 1, 1},
    {ENC_DATE, 1, 1},
    {ENC_U32, 1, 1},
    {ENC_ASCII, 1, 1},
    {ENC_ASCII, 1, 1},
    {ENC_ASCII, 1, 1},
    {ENC_ASCII, 1, 1},
    {ENC_VERSION, 1, 1},
    {ENC_U16, 1, 1},
    {ENC_U16, 1, 1},
    {ENC_CLOCK, 1, 1},
    {ENC_DATE, 1, 1},
    {ENC_BOOL, 1, 1},
    {ENC_U16, 1, 1},
    {ENC_U16, 1, 1},
    {ENC_U16, 1, 1},
    {ENC_U16, 1, 1},
    {ENC_U16, 1, 1},
    {ENC_U32, 1, 1},
    {ENC_U32, 1, 1},
    {ENC_U32, 1, 1},
    {ENC_U32, 1, 1},
    {ENC_U32, 1, 1},
    {ENC_U32, 1, 1},
    {ENC_U16, 1, 1},
    {ENC_U16, 1, 1},
    {ENC_U16, 1, 1},
    {ENC_U16, 1, 1},
    {ENC_U16, 1, 1},
    {ENC_U16, 1, 1},
    {ENC_U16, 1, 1},
    {ENC_U16, 1, 1},
    {ENC_DATE, 1, 1},
    {ENC_U16, 1, 1},
    {ENC_U16, 1, 1},
};

const ats_scan_block_t ats_scan_blocks[ATS_BLOCK_COUNT] = {
    {0, 19, 2000u, 6000u, "electrical-overview"},
    {40, 1, 10000u, 30000u, "synchronous-angle"},
    {44, 1, 10000u, 30000u, "reported-rotation"},
    {56, 1, 10000u, 30000u, "operating-mode"},
    {74, 3, 10000u, 30000u, "active-delay"},
    {193, 10, 10000u, 30000u, "physical-io"},
    {249, 4, 10000u, 30000u, "software-io"},
    {741, 2, 5000u, 15000u, "accessory-dip-status"},
    {3449, 1, 10000u, 30000u, "keypress"},
    {45, 8, 60000u, 180000u, "nominal-settings"},
    {58, 14, 60000u, 180000u, "delay-settings"},
    {77, 26, 60000u, 180000u, "trip-settings"},
    {153, 4, 60000u, 180000u, "expansion-presence"},
    {159, 2, 60000u, 180000u, "option-presence"},
    {739, 1, 60000u, 180000u, "accessory-setup"},
    {904, 4, 60000u, 180000u, "next-exercise"},
    {909, 4, 60000u, 180000u, "exercise-schedule"},
    {1009, 4, 60000u, 180000u, "last-outage"},
    {1109, 40, 60000u, 180000u, "identity-text"},
    {1199, 3, 60000u, 180000u, "old-map-firmware-fingerprint"},
    {1249, 3, 60000u, 180000u, "controller-clock"},
    {1294, 26, 60000u, 180000u, "transfer-history"},
    {9998, 1, 60000u, 180000u, "device-type"},
};
